## Yocto-build-configs/rpi-build/conf/local.conf
```bitbake
MACHINE ??= "raspberrypi4-64"
LICENSE_FLAGS_ACCEPTED="synaptics-killswitch"

DISTRO_FEATURES:append = " security"

BB_HASHSERVE_UPSTREAM = "hashserv.yocto.io:8687"
SSTATE_MIRRORS ?= "file://.* http://sstate.yoctoproject.org/all/PATH;downloadfilename=PATH"
BB_HASHSERVE = "auto"
BB_SIGNATURE_HANDLER = "OEEquivHash"

DISTRO ?= "poky"
PACKAGE_CLASSES ?= "package_rpm"
EXTRA_IMAGE_FEATURES ?= "debug-tweaks"
USER_CLASSES ?= "buildstats"
PATCHRESOLVE = "noop"
BB_DISKMON_DIRS ??= "\
    STOPTASKS,${TMPDIR},1G,100K \
    STOPTASKS,${DL_DIR},1G,100K \
    STOPTASKS,${SSTATE_DIR},1G,100K \
    STOPTASKS,/tmp,100M,100K \
    HALT,${TMPDIR},100M,1K \
    HALT,${DL_DIR},100M,1K \
    HALT,${SSTATE_DIR},100M,1K \
    HALT,/tmp,10M,1K"

CONF_VERSION = "2"
```

## Yocto-build-configs/rpi-with-oscap-nettools-pip/conf/bblayers.conf
```bitbake
# POKY_BBLAYERS_CONF_VERSION is increased each time build/conf/bblayers.conf
# changes incompatibly
POKY_BBLAYERS_CONF_VERSION = "2"

BBPATH = "${TOPDIR}"
BBFILES ?= ""

BBLAYERS ?= " \
  /home/pokybuild/poky/poky/meta \
  /home/pokybuild/poky/poky/meta-poky \
  /home/pokybuild/poky/poky/meta-yocto-bsp \
  /home/pokybuild/poky/poky/meta-raspberrypi \
  "

BBLAYERS += "${TOPDIR}/../meta-openembedded/meta-oe"
BBLAYERS += "${TOPDIR}/../meta-openembedded/meta-python"
BBLAYERS += "${TOPDIR}/../meta-security/meta-security-compliance"
BBLAYERS += "${TOPDIR}/../meta-openembedded/meta-perl"
BBLAYERS += "${TOPDIR}/../meta-dtn7-go"
```
